## Kconfig
```kconfig
# Copyright (c) 2019 Nordic Semiconductor
#
# SPDX-License-Identifier: LicenseRef-Nordic-5-Clause
#

DT_COMPAT_ZMK_BEHAVIOR_BATT_PCT_PRINTER := zmk,behavior-battery-percentage-printer

config ZMK_BEHAVIOR_BATT_PCT_PRINTER
		bool
		default $(dt_compat_enabled,$(DT_COMPAT_ZMK_BEHAVIOR_BATT_PCT_PRINTER))
```

## dts/bindings/zmk,behavior-battery-percentage-printer.yaml
```yaml
# SPDX-License-Identifier: MIT

description: "Behavior that types the battery percentage."

compatible: "zmk,behavior-battery-percentage-printer"

include: zero_param.yaml
```
